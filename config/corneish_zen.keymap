/*
*
* Copyright (c) 2021 Darryl deHaan
* SPDX-License-Identifier: MIT
*
*/
c
#include <behaviors.dtsi>
#include <dt-bindings/zmk/keys.h>
#include <dt-bindings/zmk/bt.h>
#include <dt-bindings/zmk/outputs.h>

/ {
  chosen {
    zmk,matrix_transform = &default_transform;
    //zmk,matrix_transform = &five_column_transform;
  };
};


#define _BASE       0  // base keyboard
#define _CURS       1  // cursors
#define _NUM        2  // numbers and operations
#define _BLUETOOTH  3  // layer to manage blue tooth connection
#define _FUNL       4  // Function keys
#define _SYMB       5  // Parenthesis


#define MEH  LC(LS(LALT))
#define HYPR LC(LS(LG(LALT)))

// Left hand
#define MY_E       &mt MEH E
#define MY_R       &mt HYPR R

#define MY_A       &mt LGUI A
#define MY_1       &mt LGUI N1
#define MY_F1      &mt LGUI F1

#define MY_S       &mt LALT S
#define MY_2       &mt LALT N2
#xxxdefine MY_F2      &mt LALT F2

#define MY_D       &mt LCTRL D
#define MY_3       &mt LCTRL N3
#define MY_F3      &mt LCTRL F3

#define MY_F       &mt LSHIFT F
#define MY_4       &mt LSHIFT N4
#define MY_F4      &mt LSHIFT F4

// Right hand
#define MY_I       &mt LC(LS(LALT)) I
#define MY_U       &mt LC(LS(LG(LALT))) U

#define MY_J       &mt RSHIFT J
#define MY_7       &mt RSHIFT N7
#define MY_F7      &mt RSHIFT F7

#define MY_K       &mt RCTRL K
#define MY_8       &mt RCTRL N8
#define MY_F8      &mt RCTRL F8

#define MY_L       &mt RALT L
#define MY_9       &mt RALT N9
#define MY_F9      &mt RALT F9

#define MY_SEMI    &mt RGUI SEMI
#define MY_0      &mt RGUI N0
#define MY_F10     &mt RGUI F10

// Thumb cluster
#define MY_RET     &lt _CURS RET
#define MY_BSPC    &lt _SYMB BSPC

#define MY_SPACE   &lt _NUM SPACE
#define MY_DEL     &lt _FUNL DEL


/ {
    combos {
        compatible = "zmk,combos";
        combo_T {
            timeout-ms = <50>;
            key-positions = <2 3>;
            bindings = <&kp T>;
        };

        combo_G {
            timeout-ms = <50>;
            key-positions = <12 13>;
            bindings = <&mt LC(LSHIFT) G>;
        };


        combo_B {
            timeout-ms = <50>;
            key-positions = <22 23>;
            bindings = <&kp B>;
        };
    };
};


/ {
    macros {
        arrow: arrow {
            compatible = "zmk,behavior-macro";
            #binding-cells = <0>;
            bindings = <&macro_tap &kp MINUS &kp GT>;
        };

        fat_arrow: fat_arrow {
            compatible = "zmk,behavior-macro";
            #binding-cells = <0>;
            bindings = <&macro_tap &kp EQUAL &kp GT>;
        };

        back_arrow: back_arrow {
            compatible = "zmk,behavior-macro";
            #binding-cells = <0>;
            bindings = <&macro_tap &kp LT &kp MINUS>;
        };

        fsharp_pipe: fsharp_pipe {
            compatible = "zmk,behavior-macro";
            #binding-cells = <0>;
            bindings = <&macro_tap &kp PIPE &kp GT>;
        };

        fsharp_backpipe: fsharp_backpipe {
            compatible = "zmk,behavior-macro";
            #binding-cells = <0>;
            bindings = <&macro_tap &kp LT &kp PIPE>;
        };

        bind: bind {
            compatible = "zmk,behavior-macro";
            #binding-cells = <0>;
            bindings = <&macro_tap &kp GT &kp GT &kp EQUAL>;
        };

        reverse_bind: reverse_bind {
            compatible = "zmk,behavior-macro";
            #binding-cells = <0>;
            bindings = <&macro_tap &kp EQUAL &kp LT &kp LT >;
        };



        cotab: cotab {
            compatible = "zmk,behavior-macro";
            #binding-cells = <0>;
            bindings
                = <&macro_press &kp LSHFT>
                , <&macro_tap &kp TAB>
                , <&macro_release &kp LSHFT>
                ;
        };

        go_blue: go_blue {
            compatible = "zmk,behavior-macro";
            #binding-cells = <0>;
            bindings
                = <&macro_tap &kp B  &kp T  &kp SPC>
                , <&to _BLUETOOTH>
                ;
        };

        blue_0: blue_0 {
            compatible = "zmk,behavior-macro";
            #binding-cells = <0>;
            bindings
                = <&macro_tap &kp B  &kp T  &kp MINUS  &kp N0  &kp SPC>
                , <&bt BT_SEL 0>
                ;
        };

        blue_1: blue_1 {
            compatible = "zmk,behavior-macro";
            #binding-cells = <0>;
            bindings
                = <&macro_tap &kp B  &kp T  &kp MINUS  &kp N1  &kp SPC>
                , <&bt BT_SEL 1>
                ;
        };


        blue_clr: blue_clr {
            compatible = "zmk,behavior-macro";
            #binding-cells = <0>;
            bindings
                = <&macro_tap &kp B  &kp T  &kp MINUS  &kp C &kp L &kp R  &kp SPC>
                , <&bt BT_CLR >
                ;
        };
    };
};


&mt {
    flavor = "tap-preferred";
    tapping-term-ms = <150>;
    quick-tap-ms = <120>;
    require-prior-idle-ms= <120>;
};


/ {
        keymap {
                compatible = "zmk,keymap";

                // _BASE 0
                default_layer {
                        label = "Arialdo";
//  ------------------------------    -----------------------------
// |  Q  |  W  |  E  |  R  |  T  |   |  Y  |  U  |  I  |  O  |  P  |
// |     |     | Meh | Hypr|     |   |     |Hypr | Meh |     |     |
//  ------------------------------    -----------------------------
// |  A  |  S  |  D  |  F  |  G  |   |  H  |  J  |  K  |  L  |  ;  |
// | GUI | ALT | CTL | SHT |     |   |     | SHT | CTL | ALT | GUI |
//  ------------------------------    -----------------------------
// |  Z  |  X  |  C  |  V  |  B  |   |  N  |  M  |  ,  |  .  |  /  |
// |     |     |     |     |     |   |     |     |     |     |     |
//  ------------------------------    -----------------------------
//
//       -----    -----    -----       -----    -----    ----- 
//      |     |  | BSP |  | RET |     |Space|  | DEL |  |     |
//     |     |  |_SYMB|  |_CURS|     |_NUM |  |_FUNL|  |     |
//      -----    -----    -----       -----    -----    ----- 

                        bindings = <
   &none   &kp Q  &kp W  MY_E         MY_R   &kp T         &kp Y  MY_U     MY_I          &kp O    &kp P      &none 
   &none   MY_A   MY_S   MY_D         MY_F   &kp G         &kp H  MY_J     MY_K            MY_L     MY_SEMI    &none 
   &none   &kp Z  &kp X  &kp C        &kp V  &kp B         &kp N  &kp M    &kp COMMA       &kp DOT  &kp FSLH   &none 
                     &none    MY_BSPC    MY_RET    MY_SPACE   MY_DEL  &none 
                        >;
                };

                // _CURS 1
                cursors_layer {
                        label = "Arialdo";

//  ------------------------------    -----------------------------
// |  `  |     |     |     |     |   | Ins | Home|  ^  | End |  "  |
// |     |     | Meh | Hypr|     |   |     |     |     |     |     |
//  ------------------------------    -----------------------------
// |     | <-- |     |     |     |   | Caps| <-- | Down| --> |  '  |
// | Gui | Alt | Ctl |Shft |     |   |     |     |     |     |     |
//  ------------------------------    -----------------------------
// |_BLUE|     |     |     |     |   |     | PgUp|Contx|PgDwn|  \  |
// |     |     |     |     |     |   |     |     |     |     |     |
//  ------------------------------    -----------------------------
//
//      -----     -----    -----       -----    -----    ----- 
//     |     |   |     |  |     |     | TAB |  |     |  |     |
//     |     |   |     |  |     |     |     |  |     |  |     |
//      -----     -----    -----       -----    -----    ----- 

                        bindings = <
   &none      &kp GRAVE  &none         &kp MEH      &kp HYPR     &none          &kp INS         &kp HOME   &kp UP    &kp END    &kp DOUBLE_QUOTES   &none 
   &none      &kp LGUI   &mt LALT LEFT &kp LCTRL    &kp LSHIFT   &none         &caps_word      &kp LEFT   &kp DOWN  &kp RIGHT  &kp SINGLE_QUOTE    &none 
   &none      &go_blue   &none         &none        &none        &none        &none            &kp PG_UP  &kp K_APP &kp PG_DN  &kp BACKSLASH       &none 
                                    &none   &none   &none        &kp TAB  &none     &none 
                        >;
                };


                // _NUM = 2
                numbers_layer {
                        label = "Arialdo";


//  ------------------------------    -----------------------------
// |  !  |  @  |  #  |  $  |  %  |   |     |  -  |  =  |  +  |  *  |
// |     |     |     |     |     |   |     |     |     |     |     |
//  ------------------------------    -----------------------------
// |  1  |  2  |  3  |  4  |  5  |   |  6  |  7  |  8  |  9  |  0  |
// |     |     |     |     |     |   |     |     |     |     |     |
//  ------------------------------    -----------------------------
// |  ^  |  &  |     |     |     |   |     |     |     |     |     |
// |     |     |     |     |     |   |     |     |  ,  |  .  |     |
//  ------------------------------    -----------------------------
//
//      -----     -----    -----       -----    -----    ----- 
//     |     |   | BSP |  |CoTab|     |     |  |     |  |     |
//     |     |   |     |  |     |     |     |  |     |  |     |
//      -----     -----    -----       -----    -----    ----- 


                        bindings = <
   &none      &kp EXCL     &kp AT       &kp HASH     &kp DLLR     &kp PERCENT    &none    &kp MINUS   &kp EQUAL   &kp PLUS  &kp STAR   &none 
   &none      MY_1         MY_2         MY_3         MY_4         &kp N5         &kp N6   MY_7        MY_8        MY_9      MY_0       &none 
   &none      &kp CARET    &kp AMPS     &none        &none        &none          &none    &none       &kp COMMA   &kp DOT   &none      &none 
                          	        &none        &kp BSPC     &cotab         &none    &none       &none 
                        >;
                };


                // _BLUETOOTH = 3
                bluetooth_layer {
                        label = "Bluetooth";

//  ------------------------------    -----------------------------
// |Tggle|     |     |     |     |   |     |     |     |     |     |
// |     |     |     |     |     |   |     |     |     |     |     |
//  ------------------------------    -----------------------------
// | BT1 | BT2 | BT3 | BT4 |     |   |     |     |     |     | BT0 |
// |     |     |     |     |     |   |     |     |     |     |     |
//  ------------------------------    -----------------------------
// | CLR |_BASE|     |     |     |   |     |     |     |     |     |
// |     |     |     |     |     |   |     |     |     |     |     |
//  ------------------------------    -----------------------------
//
//      -----     -----    -----       -----    -----    ----- 
//     |     |   |     |  |     |     |     |  |     |  |     |
//     |     |   |     |  |     |     |     |  |     |  |     |
//      -----     -----    -----       -----    -----    ----- 

                        bindings = <
   &none      &out OUT_TOG   &none         &none         &none         &none          &none    &none    &none   &none    &none    &none 
   &none      &blue_1        &bt BT_SEL 2  &bt BT_SEL 3  &bt BT_SEL 4  &none          &none    &none    &none   &none    &blue_0  &none 
   &none      &blue_clr      &to _BASE     &none         &none         &none          &none    &none    &none   &none    &none    &none 
                          	    &none      &none        &none       &none   &none    &none 
                        >;
                };


                // _FUNCTION = 4
                function_layer {
                        label = "Arialdo";

//  ------------------------------    -----------------------------
// | F11 | F12 | F13 | F14 | F15 |   | F16 | F17 | F18 | F19 | F20 |
// |     |     |     |     |     |   |     |     |     |     |     |
//  ------------------------------    -----------------------------
// | F1  | F2  | F3  | F4  | F5  |   | F6  | F7  | F8  | F9  | F10 |
// |     |     |     |     |     |   |     |     |     |     |     |
//  ------------------------------    -----------------------------
// | F21 | F22 | F23 | F24 |     |   |     |     |     |     |     |
// |     |     |     |     |     |   |     |     |     |     |     |
//  ------------------------------    -----------------------------
//
//      -----     -----    -----       -----    -----    ----- 
//     |     |   |     |  | Esc |     |     |  |     |  |     |
//     |     |   |     |  |     |     |     |  |     |  |     |
//      -----     -----    -----       -----    -----    ----- 

                        bindings = <
   &none      &kp F11      &kp F12      &kp F13      &kp F14      &kp F15        &kp F16  &kp F17  &kp F18  &kp F19  &kp F20  &none 
   &none      MY_F1        MY_F2        MY_F3        MY_F4        &kp F5         &kp F6   MY_F7    MY_F8    MY_F9    MY_F10   &none 
   &none      &kp F21      &kp F22      &kp F23      &kp F24      &none          &none    &none    &none    &none    &none    &none 
                                            &none    &none        &kp ESC        &none   &none    &none 
                        >;
                };



                // _SYMB = 5
                symbols_layer {
                        label = "Arialdo";


//  ------------------------------    -----------------------------
// |     |     |     |     |     |   |  |  |  _  |  *  |  ~  |     |
// |     |     |     |     |     |   |     |     |     |     |     |
//  ------------------------------    -----------------------------
// |  <  |  {  |  [  |  (  |     |   |     |  )  |  ]  |  }  |  >  |
// |     |     |     |     |     |   |     |     |     |     |     |
//  ------------------------------    -----------------------------
// |     |     |     | <-  | <|  |   |  |> |  -> |  => | >>= | <*> |
// |     |     |     |     |     |   |     |     |     |     |     |
//  ------------------------------    -----------------------------
//
//      -----     -----    -----       -----    -----    ----- 
//     |     |   |     |  |     |     |     |  |     |  |     |
//     |     |   |     |  |     |     |     |  |     |  |     |
//      -----     -----    -----       -----    -----    ----- 

                          bindings = <
      &none   &none        &none          &none        &none        &none             &kp PIPE     &kp UNDER  &kp STAR    &kp TILDE  &none        &none 
      &none   &kp LT       &kp LBRC       &kp LBKT     &kp LPAR     &none             &none        &kp RPAR   &kp RBKT  &kp RBRC     &kp GT       &none 
      &none   &none        &reverse_bind  &none        &back_arrow  &fsharp_backpipe  &fsharp_pipe &arrow     &fat_arrow    &bind    &kp BSLH     &none 
                        	              &none   &none        &none       &none   &none    &none 
                        >;
                };


                // EMPTY = 6
                empty_layer {
                        label = "EMPTY";

//  ------------------------------    -----------------------------
// |     |     |     |     |     |   |     |     |     |     |     |
// |     |     |     |     |     |   |     |     |     |     |     |
//  ------------------------------    -----------------------------
// |     |     |     |     |     |   |     |     |     |     |     |
// |     |     |     |     |     |   |     |     |     |     |     |
//  ------------------------------    -----------------------------
// |     |     |     |     |     |   |     |     |     |     |     |
// |     |     |     |     |     |   |     |     |     |     |     |
//  ------------------------------    -----------------------------
//
//      -----     -----    -----       -----    -----    ----- 
//     |     |   |     |  |     |     |     |  |     |  |     |
//     |     |   |     |  |     |     |     |  |     |  |     |
//      -----     -----    -----       -----    -----    ----- 

                        bindings = <
   &none      &none        &none        &none        &none        &none          &none    &none    &none  &none     &none  &none 
   &none      &none        &none        &none        &none        &none          &none    &none    &none  &none     &none  &none 
   &none      &none        &none        &none        &none        &none          &none    &none    &none  &none     &none  &none 
                          	        &none      &none        &none       &none   &none    &none 
                        >;
                };
        };
};
